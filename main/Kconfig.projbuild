## main/Kconfig.projbuild
```kconfig
menu "Example Configuration"
    config EXAMPLE_HTTP_ENDPOINT
        string "Example HTTP Endpoint"
        default "192.168.1.187:5000"
        help
            Target endpoint host-name for the example to use.
endmenu
```
